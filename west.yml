## west.yml
```yaml
# SPDX-License-Identifier: Apache-2.0
# West yml manifest for Zephyr dom0 demo

manifest:
  remotes:
    - name: nexec_zephyr_dom0
      url-base: https://github.com/nexec/

  projects:
    - name: xenutils_dom0
      remote: nexec_zephyr_dom0
      repo-path: xenutils.git
      revision: xen_dom0_demo
    - name: zephyr
      import: false
      remote: nexec_zephyr_dom0
      repo-path: zephyr.git
      revision: v3.1.0_dom0_demo
      west-commands: scripts/west-commands.yml
```
